## base_external/Config.in
```kconfig
source "$BR2_EXTERNAL_assignment_base_PATH/package/audioeqdriver/Config.in"
source "$BR2_EXTERNAL_assignment_base_PATH/package/aesd-assignments/Config.in"
```

## base_external/package/audioeqdriver/Config.in
```kconfig
config BR2_PACKAGE_AUDIO_EQ_DRIVER
	bool "audioeqdriver"
	help
	  Includes the audioeqdreiver executable and start up script
```
